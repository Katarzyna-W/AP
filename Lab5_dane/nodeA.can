/*@!Encoding:1250*/
includes
{
}

variables
{
  message ThrottleMsg thm;
}

on envVar ThrottleState {
  thm.ThrottleRawValue = @ThrottleState;
  thm.ThrottleValue = @ThrottleState/2500;
  output(thm);
}

