/*@!Encoding:1250*/
includes
{ 
  #include "nodeA.can"
}

variables
{
 //msTimer timer100;
  message EngineMsg eng;

}
on start{
  //setTimer(timer100, 100);
  @EngineRotations = 0;
}/*
on timer timer100{
  eng.EngineSpeedRawValue=(1.0-0.5*0.1)*getValue(EngineRotations)+0.75*0.1*thm.ThrottleValue;
  eng.EngineSpeedValue = 1500*getValue(EngineRotations);
  @EngineRotations= eng.EngineSpeedValue; 
  output(eng);
  setTimer(timer100, 100);
}*/

on message 0x100{
  write("ER: %f", @EngineRotations);
  eng.EngineSpeedRawValue=0.95*@EngineRotations+0.75*0.1*thm.ThrottleValue;
  eng.EngineSpeedValue = 1500*eng.EngineSpeedRawValue;
  @EngineRotations= eng.EngineSpeedValue; 
  output(eng);
  //setTimer(timer100, 100);

}
