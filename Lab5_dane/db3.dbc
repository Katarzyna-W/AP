VERSION ""

NS_ :

BS_:

BU_:

BO_ 512 EngineMsg: 8 Vector__XXX
 SG_ EngineSpeedValue : 32|32@1- (1,0) [0|0] "" Vector__XXX
 SG_ EngineSpeedRawValue : 0|32@1- (1,0) [0|0] "" Vector__XXX

BO_ 256 ThrottleMsg: 8 Vector__XXX
 SG_ ThrottleValue : 32|32@1- (1,0) [0|0] "" Vector__XXX
 SG_ ThrottleRawValue : 0|32@1+ (1,0) [0|4294967295] "" Vector__XXX

EV_ ThrottleState: 1 [0|2500] "" 34 1 DUMMY_NODE_VECTOR0 Vector__XXX;

EV_ EngineRotations: 1 [0|2500] "" 0 2 DUMMY_NODE_VECTOR0 Vector__XXX;

BA_DEF_  "BusType" STRING ;
BA_DEF_DEF_  "BusType" "CAN";
SIG_VALTYPE_ 512 EngineSpeedValue : 1;
SIG_VALTYPE_ 512 EngineSpeedRawValue : 1;
SIG_VALTYPE_ 256 ThrottleValue : 1;
