VERSION ""

NS_ :

BS_:

BU_:

BO_ 1280 connection: 8 Vector__XXX

BO_ 512 msg_A: 8 Vector__XXX
 SG_ x : 0|32@1- (1,0) [-3.4E+038|3.4E+038] "" Vector__XXX

BO_ 1024 msg_B: 4 Vector__XXX
 SG_ y : 0|32@1- (1,0) [-3.4E+038|3.4E+038] "" Vector__XXX

SIG_VALTYPE_ 512 x : 1;
SIG_VALTYPE_ 1024 y : 1;
