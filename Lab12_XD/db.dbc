VERSION ""

NS_ :

BS_:

BU_:

BO_ 2 Response: 8 Vector__XXX
 SG_ U : 63|8@1- (1,0) [0|0] "" Vector__XXX
 SG_ PID : 63|8@1- (1,0) [0|0] "" Vector__XXX
 SG_ Mode : 56|8@1- (1,0) [0|0] "" Vector__XXX
 SG_ Length : 48|8@1- (1,0) [0|0] "" Vector__XXX
 SG_ Id : 32|11@1- (1,0) [0|0] "" Vector__XXX
 SG_ Dh : 24|8@1- (1,0) [0|0] "" Vector__XXX
 SG_ Ch : 16|8@1- (1,0) [0|0] "" Vector__XXX
 SG_ Bh : 8|8@1- (1,0) [0|0] "" Vector__XXX
 SG_ Ah : 0|8@1- (1,0) [0|0] "" Vector__XXX

BO_ 1 Request: 8 Vector__XXX
 SG_ U : 63|8@1- (1,0) [0|0] "" Vector__XXX
 SG_ PID : 63|8@1- (1,0) [0|0] "" Vector__XXX
 SG_ Mode : 56|8@1- (1,0) [0|0] "" Vector__XXX
 SG_ Length : 48|8@1- (1,0) [0|0] "" Vector__XXX
 SG_ Id : 32|11@1- (1,0) [0|0] "" Vector__XXX
 SG_ Dh : 24|8@1- (1,0) [0|0] "" Vector__XXX
 SG_ Ch : 16|8@1- (1,0) [0|0] "" Vector__XXX
 SG_ Bh : 8|8@1- (1,0) [0|0] "" Vector__XXX
 SG_ Ah : 0|8@1- (1,0) [0|0] "" Vector__XXX

BA_DEF_  "BusType" STRING ;
BA_DEF_DEF_  "BusType" "CAN";
