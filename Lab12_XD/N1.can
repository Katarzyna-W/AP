/*@!Encoding:1250*/
includes
{
  #include "N2.can"
}

variables
{

}

on sysvar button{

  output(rq);
  
  
}