/*@!Encoding:1250*/
includes
{
  
}

variables
{
  message Request rq;
  message Response rs;
  float Velocity = 0x32;
  float IntakePressure = 0x64;
  float Rpm = 0xD6;
}

on message 0x1{
  rs.Id = 7E8;
  rs.Length = 0x03;
  rs.Mode = 0x41;
  rs.PID = 0x0D;
  rs.Bh = 0xaa;
  rs.Ch = 0xaa;
  rs.Dh = 0xaa;
  rs.U = 0xaa;
  if(rq.PID == 0x0B){
    rs.Ah = IntakePressure; 
  }
  if(rq.PID == 0x0C){
    rs.Ah = 600*Rpm; 
  }
  if(rq.PID == 0x0D){
    rs.Ah = Velocity; 
  }
  output(rs);
}
